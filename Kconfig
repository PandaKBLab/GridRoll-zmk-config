## Kconfig
```kconfig
# SPDX-License-Identifier: MIT
config GRIDROLL_STATUS_LED
    bool "GridRoll low-battery and host Bluetooth status"
    depends on ZMK_BATTERY_REPORTING && GPIO && SOC_NRF52840
    help
      Use actual battery sample results, never the initial cached zero percent.
      Red LEDs are off in idle/sleep. Right host connection indication is bounded;
      the left red LED indicates only its own battery. No charge-complete estimate.

config GRIDROLL_WHEEL_STEP
    bool "Discrete encoder wheel steps"
    depends on ZMK_POINTING && ZMK_RUNTIME_INPUT_PROCESSOR && ZMK_SPLIT_ROLE_CENTRAL
    default y if DT_HAS_GRIDROLL_BEHAVIOR_WHEEL_STEP_ENABLED

config GRIDROLL_USB_AUTO_OUTPUT
    bool "Prefer USB when the computer enumerates the keyboard"
    depends on ZMK_USB && ZMK_BLE && ZMK_SPLIT_ROLE_CENTRAL
    help
      Select USB on each new HID-ready connection and after settings load.
      Charge-only connections leave the selected output unchanged. Manual BLE
      selection remains available until the next USB connection.

config GRIDROLL_PAW3222
    bool "GridRoll PAW3222 single-wire input driver"
    default y if DT_HAS_PANDAKB_PAW3222_SDIO_ENABLED
    depends on GPIO && INPUT

config GRIDROLL_PAW3222_LOG_LEVEL
    int "PAW3222 log level (0 off, 1 error, 3 info, 4 debug)"
    range 0 4
    default 3
    depends on GRIDROLL_PAW3222

config GRIDROLL_PAW3222_BLE_REPORT_INTERVAL_MS
    int "Minimum interval between trackball BLE reports (ms)"
    range 8 30
    default 8
    depends on GRIDROLL_PAW3222
    help
      Accumulate relative motion between BLE reports instead of filling the
      HID queue. The first movement after inactivity is immediate. USB output
      bypasses the interval; idle does not start a periodic report timer.
```

## dts/bindings/behaviors/gridroll,behavior-precision.yaml
```yaml
# SPDX-License-Identifier: MIT
description: Hold for one quarter of the normal runtime mouse speed; release restores it
compatible: "gridroll,behavior-precision"
include: zero_param.yaml
properties:
  processor-name:
    type: string
    required: true
```

## dts/bindings/behaviors/gridroll,behavior-studio-ble.yaml
```yaml
# SPDX-License-Identifier: MIT
description: Open a bounded BLE Studio discovery window without an edit lock
compatible: "gridroll,behavior-studio-ble"
include: zero_param.yaml
```
